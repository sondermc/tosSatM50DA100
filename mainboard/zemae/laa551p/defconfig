## mainboard/zemae/laa551p/defconfig
```kconfig
CONFIG_VENDOR_AMD=y
CONFIG_BOARD_AMD_OLIVEHILL=y
CONFIG_MAINBOARD_SMBIOS_PRODUCT_NAME="TOSHIBA"
CONFIG_DEFAULT_CONSOLE_LOGLEVEL_8=y
CONFIG_COREINFO_SECONDARY_PAYLOAD=y
```
